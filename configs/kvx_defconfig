## configs/kvx_defconfig
```kconfig
BR2_kvx=y
BR2_TOOLCHAIN_BUILDROOT_WCHAR=y
BR2_TOOLCHAIN_BUILDROOT_CXX=y
BR2_PACKAGE_HOST_GDB=y
BR2_LINUX_KERNEL=y
BR2_LINUX_KERNEL_CUSTOM_TARBALL=y
BR2_LINUX_KERNEL_CUSTOM_TARBALL_LOCATION="$(call github,kalray,linux_coolidge,6b6e8a4d2dfd4c48f108963578712d4caef4513d)/linux-6b6e8a4d2dfd4c48f108963578712d4caef4513d.tar.gz"
BR2_LINUX_KERNEL_DEFCONFIG="default"
BR2_PACKAGE_DTC=y
BR2_PACKAGE_DTC_PROGRAMS=y
BR2_TARGET_ROOTFS_INITRAMFS=y
# BR2_TARGET_ROOTFS_TAR is not set
BR2_TARGET_BAREBOX=y
BR2_TARGET_BAREBOX_CUSTOM_TARBALL=y
BR2_TARGET_BAREBOX_CUSTOM_TARBALL_LOCATION="$(call github,kalray,barebox,267974e2d1b266d87c6385bd0479f91971a2d5ca)/barebox-267974e2d1b266d87c6385bd0479f91971a2d5ca.tar.gz"
BR2_TARGET_BAREBOX_BOARD_DEFCONFIG="generic"
```

## package/libc-test/Config.in
```kconfig
config BR2_PACKAGE_LIBC_TEST
	bool "libc-test"
	select BR2_PACKAGE_MAKE
	select BR2_PACKAGE_BINUTILS
	select BR2_PACKAGE_BINUTILS_TARGET
	help
	  Enabling this option will compile and install the libc-test suite.
	  libc-test is a libc-agnostic test suite for standard C libraries.
	  libc-test is also the official test suite for the musl libc.

	  The test suite will be installed into
	  /usr/lib/libc-test directory. To run the test suite
	  enter the /usr/lib/libc-test/ directory and type
	  "make run".

	  See /usr/lib/libc-test/README for additional
	  information.

	  This is not needed at all for normal builds, so you can
	  safely say no if you do not plan to dig into your C library.

	  http://nsz.repo.hu/git/?p=libc-test
```

## package/musl/Config.in
```kconfig
config BR2_PACKAGE_MUSL
	bool
	default y
	depends on BR2_TOOLCHAIN_USES_MUSL
	select BR2_PACKAGE_LINUX_HEADERS
	# SSP broken on i386/ppc: http://www.openwall.com/lists/musl/2016/12/04/2
	select BR2_TOOLCHAIN_HAS_SSP if BR2_PACKAGE_HOST_BINUTILS_SUPPORTS_CFI \
		&& !(BR2_i386 || BR2_powerpc)
	# Compatibility headers: cdefs.h, queue.h
	select BR2_PACKAGE_MUSL_COMPAT_HEADERS
	help
	  https://www.musl-libc.org/

choice
	prompt "Musl Version"
	default BR2_MUSL_VERSION_1_2_3
	default BR2_MUSL_VERSION_KVX if BR2_kvx
	help
	  Select the version of binutils you wish to use.

config BR2_MUSL_VERSION_1_2_3
	bool "musl 1.2.3"

config BR2_MUSL_VERSION_KVX
	bool "musl kvx"
	depends on BR2_kvx

config BR2_MUSL_CUSTOM_VERSION
	bool "musl custom"

endchoice

config BR2_MUSL_CUSTOM_VERSION_VALUE
	string "musl version"
	depends on BR2_MUSL_CUSTOM_VERSION

config BR2_MUSL_VERSION
	string
	default BR2_MUSL_CUSTOM_VERSION_VALUE if BR2_MUSL_CUSTOM_VERSION
	default "e3fa678e75994559b26d543705b93069345892ed" if BR2_MUSL_VERSION_KVX
	default "1.2.3" if BR2_MUSL_VERSION_1_2_3
```

## package/rauc/Config.in
```kconfig
config BR2_PACKAGE_RAUC
	bool "rauc"
	depends on BR2_TOOLCHAIN_HAS_THREADS # glib2
	depends on BR2_USE_MMU # glib2
	depends on BR2_USE_WCHAR # glib2
	select BR2_PACKAGE_LIBGLIB2
	select BR2_PACKAGE_OPENSSL
	select BR2_PACKAGE_DBUS
	select BR2_PACKAGE_SQUASHFS # run-time dependency
	select BR2_PACKAGE_UBOOT_TOOLS if BR2_TARGET_UBOOT # run-time dependency
	select BR2_PACKAGE_UBOOT_TOOLS_FWPRINTENV if BR2_TARGET_UBOOT
	help
	  RAUC is the Robust Auto-Update Controller developed by
	  Pengutronix. It supports updating embedded Linux
	  systems over the network or from disks and provides a
	  d-bus interface.

	  http://rauc.io/

if BR2_PACKAGE_RAUC

choice
	prompt "RAUC Version"
	default BR2_RAUC_VERSION_KVX if BR2_kvx
	help
	  Select the version of rauc you wish to use.

config BR2_RAUC_VERSION_KVX
	bool "RAUC KVX"
	depends on BR2_kvx

config BR2_RAUC_CUSTOM_VERSION
	bool "Custom version"
	help
	  This option allows to use a specific official versions

endchoice

config BR2_RAUC_CUSTOM_VERSION_VALUE
	string "RAUC version"
	depends on BR2_RAUC_CUSTOM_VERSION

config BR2_RAUC_VERSION
	string
	default BR2_RAUC_CUSTOM_VERSION_VALUE if BR2_RAUC_CUSTOM_VERSION
	default "19f3bb2e38be375d5febfbf6e517623a3da5d703" if BR2_RAUC_VERSION_KVX
	default "1.5.1"

config BR2_PACKAGE_RAUC_NETWORK
	bool "network support"
	select BR2_PACKAGE_LIBCURL
	help
	  This option enables support for updating firmware over
	  the network using libcurl.

config BR2_PACKAGE_RAUC_JSON
	bool "JSON output support"
	select BR2_PACKAGE_JSON_GLIB
	help
	  This option enables support for providing output in
	  JSON format.

endif

comment "rauc needs a toolchain w/ wchar, threads"
	depends on !BR2_USE_WCHAR || !BR2_TOOLCHAIN_HAS_THREADS
	depends on BR2_USE_MMU
```

## package/strace/Config.in
```kconfig
config BR2_PACKAGE_STRACE
	bool "strace"
	# needs at least kernel headers 4.0 on nios2
	depends on BR2_TOOLCHAIN_HEADERS_AT_LEAST_4_0 || !BR2_nios2
	# needs at least kernel headers 5.0 on xtensa
	depends on BR2_TOOLCHAIN_HEADERS_AT_LEAST_5_0 || !BR2_xtensa
	depends on !BR2_nds32 && !BR2_RISCV_32
	help
	  A useful diagnostic, instructional, and debugging tool.
	  Allows you to track what system calls a program makes
	  while it is running.

	  If you want 'strace -k' to work, make sure to enable the
	  'libunwind' package.

	  https://strace.io

comment "strace needs a toolchain w/ headers >= 4.0 on nios2"
	depends on BR2_nios2
	depends on !BR2_TOOLCHAIN_HEADERS_AT_LEAST_4_0

comment "strace needs a toolchain w/ headers >= 5.0 on xtensa"
	depends on BR2_xtensa
	depends on !BR2_TOOLCHAIN_HEADERS_AT_LEAST_5_0

choice
	prompt "Strace Version"
	default BR2_STRACE_VERSION_KVX if BR2_kvx
	help
	  Select the version of strace you wish to use.

config BR2_STRACE_VERSION_KVX
	bool "Strace KVX"
	depends on BR2_kvx

config BR2_STRACE_CUSTOM_VERSION
	bool "Custom version"
	help
	  This option allows to use a specific official versions

endchoice

config BR2_STRACE_CUSTOM_VERSION_VALUE
	string "Strace version"
	depends on BR2_STRACE_CUSTOM_VERSION

config BR2_STRACE_VERSION
	string
	default BR2_STRACE_CUSTOM_VERSION_VALUE if BR2_STRACE_CUSTOM_VERSION
	default "19f3bb2e38be375d5febfbf6e517623a3da5d703" if BR2_STRACE_VERSION_KVX
	default "5.12"
```
